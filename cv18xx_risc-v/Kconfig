## cv18xx_risc-v/Kconfig
```kconfig
mainmenu "RT-Thread Project Configuration"

BSP_DIR := .

config RTT_DIR
    string
    option env="RTT_ROOT"
    default "../../.."

PKGS_DIR := packages

source "$(RTT_DIR)/Kconfig"
osource "$PKGS_DIR/Kconfig"
rsource "board/Kconfig"

config BSP_USING_CV18XX
    bool
    select ARCH_RISCV64
    select ARCH_USING_RISCV_COMMON64
    select ARCH_USING_NEW_CTX_SWITCH
    select RT_USING_SYSTEM_WORKQUEUE
    select RT_USING_COMPONENTS_INIT
    select RT_USING_USER_MAIN
    select RT_USING_CACHE
    select ARCH_MM_MMU
    select RT_USING_DEVICE_OPS
    select ARCH_REMAP_KERNEL if RT_USING_SMART
    default y

config C906_PLIC_PHY_ADDR
    hex
    default 0x70000000

config IRQ_MAX_NR
    int
    default 64

config TIMER_CLK_FREQ
    int
    default 25000000

config GPIO_IRQ_BASE
    int
    default 60

config SYS_GPIO_IRQ_BASE
    int
    default 70

config __STACKSIZE__
    int "stack size for interrupt"
    default 4096

config SOC_TYPE_CV180X
    bool
    default n

config SOC_TYPE_SG2002
    bool
    default n

choice
    prompt "Board Type"
    default BOARD_TYPE_MILKV_DUOS_EMMC

    config BOARD_TYPE_MILKV_DUOS_EMMC
        select SOC_TYPE_SG2002
        bool "milkv-duos-emmc"

    config BOARD_TYPE_MILKV_DUO256M
        select SOC_TYPE_SG2002
        bool "milkv-duo256m"

endchoice

config PKG_USING_SDHCI
    bool "Using Linux-SDHCI Driver"
    default y

    if PKG_USING_SDHCI
        config SDHCI_PLATFORM_CVITEK
            bool
            default y
        config SDHCI_PLATFORM_CVITEK_USING_EXAMPLE
            bool
            default y
        config SDHCI_PLATFORM_CVITEK_EMMC_ENABLE
            bool "Enable EMMC"
            default y
    endif

config PKG_USING_EXT4
    bool "Using Ext4"
    default y

config BSP_ROOTFS_TYPE_CROMFS
    bool "build CROMFS in kernel"
    select RT_USING_DFS_CROMFS
    select PKG_USING_ZLIB
    select PKG_USING_ZLIB_LATEST_VERSION
    default n
```

## cv18xx_risc-v/resource/dtb/milkv-duos-emmc/multi.its
```
/*
 * U-Boot uImage source file with multiple kernels, ramdisks and FDT blobs
 */

/dts-v1/;

/ {
	description = "Various kernels, ramdisks and FDT blobs";
	#address-cells = <2>;

	images {
		kernel-1 {
			description = "cvitek kernel";
			data = /incbin/("./Image.lzma");
			type = "kernel";
			arch = "riscv";
			os = "linux";
			compression = "lzma";
			load = <0x0 0x80200000>;
			entry = <0x0 0x80200000>;
			hash-2 {
				algo = "crc32";
			};
		};


		/*FDT*/
    
        fdt-cv1813h_milkv_duos_emmc {
            description = "cvitek device tree - cv1813h_milkv_duos_emmc";
            data = /incbin/("./cv1813h_milkv_duos_emmc.dtb");
            type = "flat_dt";
            arch = "riscv";
            compression = "none";
            hash-1 {
                algo = "sha256";
            };
        };



	};

	/*CFG*/
    configurations {
        
		config-cv1813h_milkv_duos_emmc {
			description = "boot cvitek system with board cv1813h_milkv_duos_emmc";
			kernel = "kernel-1";
			fdt = "fdt-cv1813h_milkv_duos_emmc";
		};

    };


};
```
